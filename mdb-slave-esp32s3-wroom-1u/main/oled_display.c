/*
 * VMflow.xyz
 *
 * oled_display.c — SSD1306 128x64 I2C OLED text driver
 *
 * Vendored rather than pulled in via a graphics library (u8g2/lvgl): this
 * board only ever needs 8 fixed text rows, which line up exactly with the
 * SSD1306's 8 hardware pages, so a full font/graphics stack would be a lot
 * of flash and a component-registry dependency for something a ~150-line
 * page-per-row driver already covers.
 *
 * I2C bring-up mirrors modem.c's AXP2101 PMU driver (same i2c_master API,
 * same bus-then-device pattern) but on its own port/pins so OLED traffic
 * never shares a bus with PMU traffic.
 */

#include <string.h>

#include <driver/i2c_master.h>
#include <esp_log.h>
#include <freertos/FreeRTOS.h>
#include <freertos/task.h>

#include "oled_display.h"

static const char *TAG = "oled_display";

/* Header is shared with the general-purpose I2C pins declared in
 * mdb-slave-esp32s3-wroom-1u.c (PIN_I2C_SDA/PIN_I2C_SCL, GPIO10/11) — kept
 * as local defines here rather than a shared header, same as modem.c does
 * for the AXP2101's I2C pins. */
#define OLED_I2C_PORT       I2C_NUM_0
#define OLED_I2C_SDA        GPIO_NUM_10
#define OLED_I2C_SCL        GPIO_NUM_11
#define OLED_I2C_ADDR       0x3C
#define OLED_I2C_CLK_HZ     400000

#define OLED_WIDTH_PX       128
#define OLED_HEIGHT_PX      64
#define OLED_PAGE_COUNT     (OLED_HEIGHT_PX / 8) /* 8 */

#define OLED_CTRL_COMMAND   0x00
#define OLED_CTRL_DATA      0x40

#define OLED_CMD_COLUMNADDR 0x21
#define OLED_CMD_PAGEADDR   0x22

/* Standard ASCII 5x7 font, printable range 0x20 (space) .. 0x7E ('~').
 * One row per character for easy auditing against the source font table.
 * Ported byte-for-byte from Adafruit-GFX-Library's glcdfont.c (MIT). */
static const uint8_t font5x7[95][5] = {
    { 0x00, 0x00, 0x00, 0x00, 0x00 }, // 0x20 ' '
    { 0x00, 0x00, 0x5F, 0x00, 0x00 }, // 0x21 '!'
    { 0x00, 0x07, 0x00, 0x07, 0x00 }, // 0x22 '"'
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    { 0x02, 0x01, 0x02, 0x04, 0x02 }, // 0x7E '~'
};

static i2c_master_bus_handle_t s_oled_bus = NULL;
static i2c_master_dev_handle_t s_oled_dev = NULL;
static bool s_oled_ready = false;

static esp_err_t oled_write_cmd_list(const uint8_t *cmds, size_t len) {
    uint8_t buf[32];
    buf[0] = OLED_CTRL_COMMAND;
    memcpy(&buf[1], cmds, len);
    return i2c_master_transmit(s_oled_dev, buf, len + 1, pdMS_TO_TICKS(100));
}

static esp_err_t oled_write_page(const uint8_t *page, size_t len) {
    uint8_t buf[1 + OLED_WIDTH_PX];
    buf[0] = OLED_CTRL_DATA;
    memcpy(&buf[1], page, len);
    return i2c_master_transmit(s_oled_dev, buf, len + 1, pdMS_TO_TICKS(100));
}

void oled_display_init(void) {
    i2c_master_bus_config_t bus_cfg = {
        .clk_source        = I2C_CLK_SRC_DEFAULT,
        .i2c_port          = OLED_I2C_PORT,
        .scl_io_num        = OLED_I2C_SCL,
        .sda_io_num        = OLED_I2C_SDA,
        .glitch_ignore_cnt = 7,
        .flags             = { .enable_internal_pullup = true },
    };
    esp_err_t err = i2c_new_master_bus(&bus_cfg, &s_oled_bus);
    if (err != ESP_OK) {
        ESP_LOGW(TAG, "i2c_new_master_bus failed: %s", esp_err_to_name(err));
        return;
    }

    i2c_device_config_t dev_cfg = {
        .dev_addr_length = I2C_ADDR_BIT_LEN_7,
        .device_address  = OLED_I2C_ADDR,
        .scl_speed_hz    = OLED_I2C_CLK_HZ,
    };
    err = i2c_master_bus_add_device(s_oled_bus, &dev_cfg, &s_oled_dev);
    if (err != ESP_OK) {
        ESP_LOGW(TAG, "bus_add_device failed: %s", esp_err_to_name(err));
        i2c_del_master_bus(s_oled_bus);
        s_oled_bus = NULL;
        return;
    }

    /* Standard SSD1306 128x64 init sequence, internal charge pump
     * (SWITCHCAPVCC) — matches this module's "switch-cap charge pump"
     * datasheet note. Values cross-checked against Adafruit_SSD1306's
     * begin()/128x64 branch. */
    static const uint8_t init_cmds[] = {
        0xAE,       // Display off
        0xD5, 0x80, // Set display clock divide ratio/osc freq
        0xA8, 0x3F, // Set multiplex ratio (1/64)
        0xD3, 0x00, // Set display offset = 0
        0x40,       // Set start line = 0
        0x8D, 0x14, // Charge pump enable (internal Vpp)
        0x20, 0x00, // Memory addressing mode = horizontal
        0xA1,       // Segment remap (column 127 = SEG0)
        0xC8,       // COM scan direction remapped
        0xDA, 0x12, // COM pins hardware config
        0x81, 0xCF, // Contrast
        0xD9, 0xF1, // Pre-charge period
        0xDB, 0x40, // VCOMH deselect level
        0xA4,       // Resume to RAM content display
        0xA6,       // Normal (non-inverted) display
        0x2E,       // Deactivate scroll
        0xAF,       // Display on
    };
    err = oled_write_cmd_list(init_cmds, sizeof(init_cmds));
    if (err != ESP_OK) {
        ESP_LOGW(TAG, "SSD1306 init failed (%s) — no display on this board?", esp_err_to_name(err));
        i2c_master_bus_rm_device(s_oled_dev);
        s_oled_dev = NULL;
        i2c_del_master_bus(s_oled_bus);
        s_oled_bus = NULL;
        return;
    }

    s_oled_ready = true;
    ESP_LOGI(TAG, "SSD1306 OLED ready on I2C%d (SDA=%d SCL=%d)", OLED_I2C_PORT, OLED_I2C_SDA, OLED_I2C_SCL);

    for (uint8_t row = 0; row < OLED_DISPLAY_ROWS; row++) {
        oled_display_set_line(row, NULL);
    }
}

void oled_display_set_line(uint8_t row, const char *text) {
    if (!s_oled_ready || row >= OLED_DISPLAY_ROWS) return;

    uint8_t page_buf[OLED_WIDTH_PX];
    memset(page_buf, 0x00, sizeof(page_buf));

    size_t len = text ? strlen(text) : 0;
    if (len > OLED_DISPLAY_COLS) len = OLED_DISPLAY_COLS;

    for (size_t i = 0; i < len; i++) {
        uint8_t c = (uint8_t)text[i];
        if (c < 0x20 || c > 0x7E) c = '?';
        memcpy(&page_buf[i * 6], font5x7[c - 0x20], 5);
        /* page_buf[i*6 + 5] left at 0x00 as the 1px inter-glyph gap */
    }

    uint8_t col_range[]  = { OLED_CMD_COLUMNADDR, 0x00, OLED_WIDTH_PX - 1 };
    uint8_t page_range[] = { OLED_CMD_PAGEADDR, row, row };

    if (oled_write_cmd_list(col_range, sizeof(col_range)) != ESP_OK) return;
    if (oled_write_cmd_list(page_range, sizeof(page_range)) != ESP_OK) return;
    oled_write_page(page_buf, sizeof(page_buf));
}
